#include "stm32f10x.h"                  // Device header
//#include "Menu.h"
#include "OLED.h"
#include "stdlib.h"



const unsigned char  GROUND[] =
{
0xc8, 0xc8, 0xc8, 0x28, 0x28, 0x28, 0x8, 0xc8, 0xc8, 0x8, 0x8, 0x8, 0x8, 0x8, 0x8, 0x8, 0x8, 0x8, 0x8, 0x8, 0x8, 0x48, 0x8, 0x8, 0xc8, 0xc8, 0xc8, 0x8, 0x38, 0x38, 0x8,
0x8, 0x8, 0x8, 0x8, 0x48, 0x48, 0x8, 0x8, 0x8, 0x8, 0x8, 0x8, 0x28, 0x8, 0x48, 0x48, 0x48, 0x8, 0x8, 0x8, 0x28, 0x28, 0x8, 0x8, 0x8, 0x8, 0x8, 0x8, 0x8, 0x8, 0xc8, 0x8,
0x8, 0x8, 0x8, 0x8, 0x8, 0x8, 0x48, 0x8, 0x8, 0x8, 0x8, 0x8,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 0x8,
0x8, 0x8, 0x8, 0x48, 0x8, 0x48, 0x48, 0x8, 0x8, 0x8, 0x8, 0x8,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 0x8,
0x8, 0x8, 0x8, 0x8, 0x8, 0x8, 0x8, 0x48, 0x49, 0x8, 0x8, 0x8,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 0x38,
0x38, 0x8, 0x8, 0x8, 0x8, 0xc8, 0x8, 0x8, 0x8, 0x8, 0x8, 0xc8,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 0x8,
0x8, 0x8, 0x28, 0x28, 0x28, 0x8, 0x8, 0x48, 0x28, 0x38, 0x38, 0x8, 0x8, 0x8, 0x8, 0xc8, 0x8, 0x8,
};

const unsigned char  CLOUD[] =
{
	0x80, 0xc0, 0xe0, 0x70, 0xb0, 0xb0, 0xb0, 0x98, 0x88, 0x8e, 0x83, 0x83, 0x83, 0x81, 0x81, 0x93, 0x8e, 0x8c, 0x88, 0x88, 0x98, 0xb0, 0xf0, 0xc0
};

const unsigned char  DINO[2][32] =
{
0xe0, 0x80, 0x0, 0x0, 0x0, 0x80, 0xc0, 0xe0, 0xfe, 0xff, 0xfd, 0xbf, 0xaf, 0x2f, 0x2f, 0xe, 0x3, 0x7, 0xf, 0x1e, 0xff, 0xbf, 0x1f, 0x1f, 0x3f, 0x2f, 0x7, 0x0, 0x1, 0x0, 0x0, 0x0,
0xe0, 0x80, 0x0, 0x0, 0x0, 0x80, 0xc0, 0xe0, 0xfe, 0xff, 0xfd, 0xbf, 0xaf, 0x2f, 0x2f, 0xe, 0x3, 0x7, 0xf, 0x1e, 0x3f, 0x7f, 0x5f, 0x3f, 0xff, 0x8f, 0x7, 0x0, 0x1, 0x0, 0x0, 0x0
};


const unsigned char  DINO_JUMP[8][48] =  
{
0x0, 0x0, 0x0, 0x0, 0x0, 0x0, 0x0, 0x0, 0x0, 0x0, 0x0, 0x0,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 0x0,

0x0, 0x0, 0x0, 0x0, 0x0, 0x0, 0x0, 0x0, 0x0, 0x80, 0x80, 0x80,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 0x0,
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0x1, 0x0, 0x0, 0x1, 0x1, 0x0, 0x0, 0x0, 0x0, 0x0, 0x0,
};


const unsigned char  CACTUS_1[] = {
	0xf0, 0xf0, 0x0, 0xff, 0xff, 0x0, 0xf0, 0xf0, 0x3, 0x7, 0x86, 0xff, 0xff, 0x6, 0x3, 0x1
};

const unsigned char  CACTUS_2[] = {
	0xf0, 0xe0, 0x0, 0xff, 0xfe, 0x80, 0xfc, 0x0, 0x0, 0x7c, 0xc0, 0xfe, 0xff, 0x0, 0x80, 0xfc,
	0x3, 0x7, 0x6, 0xff, 0xff, 0x1, 0x10, 0x90, 0x90, 0x90, 0x0, 0xff, 0xff, 0x3, 0x3, 0x1
};

const unsigned char  CACTUS_3[] = {
	0xf0, 0xe0, 0x0, 0xff, 0xfe, 0x80, 0xfc, 0x0, 0xfc, 0xfe, 0x0, 0xff, 0xff, 0x0, 0xf8, 0xf0,
	0x0, 0xfe, 0x80, 0xfe, 0xff, 0xfe, 0x78, 0xfc, 0x13, 0x17, 0x6, 0xff, 0xff, 0x1, 0x10, 0x10,
	0x13, 0x37, 0x4, 0xff, 0xff, 0x8, 0xf, 0x17, 0x10, 0x10, 0x1, 0xff, 0xff, 0x3, 0x13, 0x11
};

const unsigned char  CACTUS_4[] = {
  0xf0, 0xe0, 0x0, 0xff, 0xfe, 0x0, 0xf0, 0x0, 0xc0, 0x0, 0xff, 0xfe, 0x60, 0x3c, 0x80, 0x0,
	0x0, 0x7c, 0xc0, 0xfe, 0xff, 0x0, 0xf0, 0xf8, 0x43, 0x47, 0x86, 0xff, 0xff, 0x26, 0xa3,
	0xa0, 0x27, 0x4, 0xff, 0xff, 0x0, 0x8, 0xff, 0x88, 0x2f, 0x0, 0x0, 0xff, 0xff, 0x6, 0x23, 0x21
};

const unsigned char  RESTART[] =
{
0xfc, 0xff, 0xff, 0xff, 0xff, 0xff, 0x3f, 0x3f, 0x3f, 0x3f, 0xf, 0x1f, 0x3f, 0xff, 0xff, 0xff, 0x3f, 0x3f, 0xff, 0xff, 0xff, 0xff, 0xff, 0xfc,
0xff, 0xff, 0xff, 0xff, 0xff, 0x0, 0x0, 0x7e, 0x7e, 0x7e, 0x78, 0x7c, 0x7e, 0x7f, 0x7f, 0x7f, 0x7e, 0x0, 0x0, 0xff, 0xff, 0xff, 0xff, 0xff,
0x3f, 0xff, 0xff, 0xff, 0xff, 0xff, 0xfc, 0xfc, 0xfc, 0xfc, 0xfc, 0xfc, 0xfc, 0xfc, 0xfc, 0xfc, 0xfc, 0xfc, 0xff, 0xff, 0xff, 0xff, 0xff, 0x3f,
};
const unsigned char  COVER[] = {
0x0, 0x0, 0x0, 0x0, 0x0, 0x0, 0x0, 0x0, 0xe0, 0xf0, 0x30, 0x30,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 0x0,
0x0,
0x0, 0x0, 0x0, 0x0, 0x0, 0x0, 0x0, 0x0, 0xf3, 0xf7, 0x36, 0x36, 0xf6, 0xe6, 0x0, 0xf0, 0xf7, 0x7, 0xc1, 0xc1, 0x37, 0x37, 0xf0, 0xc0, 0x7, 0xc7, 0xe0, 0x30, 0x37, 0x37,
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0x82, 0x82, 0x82, 0x2, 0x2, 0x22, 0x22, 0x22, 0x22, 0x2, 0x2, 0x2,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 0x0,
};



void OLED_DrawBMP(unsigned char x0, unsigned char y0, unsigned char x1, unsigned char y1, unsigned char BMP[])
{
	unsigned int j=0;
  unsigned char x,y;
	OLED_ShowChar(6,6,'g', 4);
  if(y1%8==0) y=y1/8;
  else y=y1/8+1;
	for(y=y0;y<y1;y++)
	{
		OLED_SetCursor(x0,y);
		for(x=x0;x<x1;x++)
	    {
	    	OLED_WriteData(BMP[j++]);
	    }
	}
}
//快速绘制图像
void OLED_DrawBMPFast(const unsigned char BMP[])
{
	unsigned int j = 0;
	unsigned char x, y;
	
	for(y = 0; y < 8; y++)
	{
		OLED_SetCursor(0, y);
		OLED_I2C_Start();
		OLED_I2C_SendByte(0x78);
		OLED_I2C_SendByte(0x40);
		for(x=0; x<128;x++)
		{
			OLED_I2C_SendByte(BMP[j++]);
		}
		OLED_I2C_Stop();
	}
}

void OLED_DrawBMP_block_clear(int bx, int by, int clear_size)
{
	unsigned int i;
	OLED_SetCursor(bx, by);
	OLED_I2C_Start();
	OLED_I2C_SendByte(0x78);
	OLED_I2C_SendByte(0x40);
	for(i=0; i< clear_size; i++)
	{
		if(bx+1>128) break;
		OLED_I2C_SendByte(0x0);
	}
	OLED_I2C_Stop();
}

void OLED_DrawGround(void)
{
	static unsigned int pos = 0;
	unsigned char speed = 5;
	unsigned int ground_length = sizeof(GROUND);
	unsigned char x;
	
	OLED_SetCursor(0, 7);
	OLED_I2C_Start();
	OLED_I2C_SendByte(0x78);
	OLED_I2C_SendByte(0x40);
	for(x = 0; x<128; x++)
	{
		OLED_I2C_SendByte(GROUND[(x+pos)%ground_length]);
	}
	OLED_I2C_Stop();
	pos = pos + speed;
}

//绘制云朵
void OLED_DrawCloud(void)
{
	static int pos = 128;
	static char height = 0;
	char speed = 3;
	unsigned int i = 0;
	int x;
	int start_x = 0;
	int length = sizeof(CLOUD);
	unsigned char byte;
	
	if(pos + length <= -speed)
	{
		pos = 128;
		height = rand()%3;
	}
	if(pos < 0)
	{
		start_x = -pos;
		OLED_SetCursor(0, 1+height);
	}
	else
	{
		OLED_SetCursor(pos, 1+height);
	}
	
	OLED_I2C_Start();
	OLED_I2C_SendByte(0x78);
	OLED_I2C_SendByte(0x40);
	for(x = start_x; x < length + speed; x++)
	{
		if(pos + x > 127) break;
		if(x < length) byte = CLOUD[x];
		else byte = 0x0;
		OLED_I2C_SendByte(byte);
	}
	OLED_I2C_Stop();
	pos = pos - speed;
}

void OLED_DrawDino(void)
{
	static unsigned char dino_dir = 0;
	unsigned int j=0;
	unsigned char x, y;
	unsigned char byte;
	
	dino_dir = dino_dir%2;
	for(y=0; y<2; y++)
	{
		OLED_SetCursor(16, 6+y);
		OLED_I2C_Start();
	  OLED_I2C_SendByte(0x78);
	  OLED_I2C_SendByte(0x40);
		for(x = 0; x < 16; x++)
		{
			j = y*16 +x;
			byte = DINO[dino_dir][j];
			
			OLED_I2C_SendByte(byte);
		}
		OLED_I2C_Stop();
	}
}

void OLED_DrawCactus(void)
{
	char speed = 5;
	static int pos = 128;
	int start_x = 0;
	int length = sizeof(CACTUS_2)/2;
	
	unsigned int j = 0;
	unsigned char x, y;
	unsigned char byte;
	
	if(pos + length <= 0)
	{
		OLED_DrawBMP_block_clear(0, 6, speed);
		pos = 128;
	}
	
	for(y = 0; y < 2; y++)
	{
		if(pos < 0)
		{
			start_x = -pos;
			OLED_SetCursor(0, 6+y);
		}
		else
		{
			OLED_SetCursor(pos, 6+y);
		}
		
		OLED_I2C_Start();
	  OLED_I2C_SendByte(0x78);
	  OLED_I2C_SendByte(0x40);
		for(x = start_x; x < length; x++)
		{
			if(pos + x > 127) break;
			j = y*length + x;
			byte = CACTUS_2[j];
			OLED_I2C_SendByte(byte);
		}
		OLED_I2C_Stop();
	}
	OLED_DrawBMP_block_clear(pos + length, 6, speed);
	pos = pos - speed;
}

// 绘制随机出现的仙人掌

int OLED_DrawCactusRandom(unsigned char ver, unsigned char reset)
{
	char speed = 5;
	static int pos = 128;
	int start_x = 0;
	int length = 0;
	
	unsigned int i=0, j=0;
	unsigned char x, y;
	unsigned char byte;
	if(reset == 1)
	{
		pos = 128;
		OLED_DrawBMP_block_clear(0, 6, speed);
		return 128;
	}
	if(ver == 0) length = 8;
	else if (ver == 1) length = 16;
	else if (ver == 2 || ver == 3) length = 24;
	
	for(y=0; y<2; y++)
	{
		if(pos < 0)
		{
			start_x = -pos;
			OLED_SetCursor(0, 6+y);
		}
		else
		{
			OLED_SetCursor(pos, 6+y);
		}
		OLED_I2C_Start();
	  OLED_I2C_SendByte(0x78);
	  OLED_I2C_SendByte(0x40);
		for(x = start_x; x < length; x++)
		{
			if(pos + x > 127) break;
			
			j = y*length + x;
			if(ver == 0) byte = CACTUS_1[j];
			else if(ver == 1) byte = CACTUS_2[j];
			else if(ver == 2) byte = CACTUS_3[j];
			else byte = CACTUS_4[j];
			OLED_I2C_SendByte(byte);
		}
		OLED_I2C_Stop();
	}
	OLED_DrawBMP_block_clear(pos + length, 6, speed);
	pos = pos - speed;
	return pos + speed;
}

//绘制跳跃的小恐龙
int OLED_DrawDinoJump(char reset)
{
	char speed_arr[] = {1, 1, 3, 3, 4, 4, 5, 6, 7};
	static char speed_idx = sizeof(speed_arr) - 1;
	static int height = 0;
	static char dir = 0;
	
	unsigned int j=0;
	unsigned char x, y;
	char offset = 0;
	unsigned char byte;
	if(reset == 1)
	{
		height = 0;
		dir = 0;
		speed_idx = sizeof(speed_arr)-1;
		return 0;
	}
	if(dir == 0)
	{
		height += speed_arr[speed_idx];
		speed_idx --;
		if(speed_idx < 0) speed_idx = 0;
	}
	if(dir == 1)
	{
		height -= speed_arr[speed_idx];
		speed_idx ++;
		if(speed_idx>sizeof(speed_arr)-1) speed_idx = sizeof(speed_arr)-1;
	}
	if(height >= 31)
	{
		dir = 1;
		height = 31;
	}
	if(height <= 0)
	{
		dir = 0;
		height = 0;
	}
	if(height <= 7) offset = 0;
	else if(height <= 15) offset = 1;
	else if(height <= 23) offset = 2;
	else if(height <= 31) offset = 3;
	else offset = 4;
	
	for(y=0; y<3; y++)
	{
		OLED_SetCursor(16, 5-offset+y);
		
		OLED_I2C_Start();
	  OLED_I2C_SendByte(0x78);
	  OLED_I2C_SendByte(0x40);
		for(x=0; x < 16; x++)
		{
			j = y*16 + x;
			byte = DINO_JUMP[height%8][j];
			
			OLED_I2C_SendByte(byte);
		}
		OLED_I2C_Stop();
	}
	if(dir == 0) OLED_DrawBMP_block_clear(16, 8 - offset, 16);
	if(dir == 1) OLED_DrawBMP_block_clear(16, 4 - offset, 16);
	return height;
}

//绘制重启
void OLED_DrawRestart(void)
{
	unsigned int j=0;
	unsigned char x, y;
	unsigned char byte;
	
	for(y = 2; y < 5; y++)
	{
		OLED_SetCursor(52, y);
		
		OLED_I2C_Start();
	  OLED_I2C_SendByte(0x78);
	  OLED_I2C_SendByte(0x40);
		for(x = 0; x <  24; x++)
		{
			byte = RESTART[j++];
			OLED_I2C_SendByte(byte);
		}
		OLED_I2C_Stop();
	}
//	OLED_ShowString(10, 3, "GAME");
//	OLED_ShowString(86, 3, "OVER");
}

void OLED_DrawCover(void)
{
	OLED_DrawBMPFast(COVER);
}